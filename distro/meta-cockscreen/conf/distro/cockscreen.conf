## distro/meta-cockscreen/conf/distro/cockscreen.conf
```bitbake
DISTRO = "cockscreen"
DISTRO_NAME = "Cockscreen Yocto"
DISTRO_VERSION = "master"
DISTRO_CODENAME = "cockscreen"

INIT_MANAGER = "sysvinit"
VIRTUAL-RUNTIME_init_manager = "sysvinit"
VIRTUAL-RUNTIME_initscripts = "initscripts"

DISTRO_FEATURES:append = " opengl alsa ipv4"
DISTRO_FEATURES:remove = " systemd x11 wayland vulkan pulseaudio pam polkit"

PREFERRED_PROVIDER_virtual/kernel = "linux-raspberrypi"
PREFERRED_VERSION_linux-raspberrypi = "6.12%"
PREFERRED_PROVIDER_virtual/libgl = "mesa"
PREFERRED_PROVIDER_virtual/egl = "mesa"
PREFERRED_PROVIDER_virtual/libgles2 = "mesa"

LICENSE_FLAGS_ACCEPTED:append = " commercial commercial_ffmpeg"
```

## distro/meta-cockscreen/conf/layer.conf
```bitbake
BBPATH .= ":${LAYERDIR}"
BBFILES += "${LAYERDIR}/recipes-*/*/*.bb ${LAYERDIR}/recipes-*/*/*.bbappend"

BBFILE_COLLECTIONS += "cockscreen"
BBFILE_PATTERN_cockscreen = "^${LAYERDIR}/"
BBFILE_PRIORITY_cockscreen = "9"

LAYERSERIES_COMPAT_cockscreen = "scarthgap whinlatter wrynose"
```

## distro/meta-cockscreen/conf/machine/cockscreen-rpi0-2w-64.conf
```bitbake
require conf/machine/raspberrypi0-2w-64.conf

MACHINEOVERRIDES =. "cockscreen-rpi0-2w-64:"

ENABLE_SPI_BUS = "1"
ENABLE_I2C = "1"
ENABLE_UART = "1"
DISABLE_OVERSCAN = "1"
GPU_MEM = "128"
VC4DTBO = "vc4-kms-v3d"

CMDLINE_DEBUG = "quiet loglevel=4"
RPI_EXTRA_CONFIG = " \
max_framebuffers=2 \
\ndtoverlay=miniuart-bt \
"

MACHINE_EXTRA_RRECOMMENDS:remove = " \
linux-firmware-rpidistro-bcm43430 \
linux-firmware-rpidistro-bcm43436 \
linux-firmware-rpidistro-bcm43436s \
linux-firmware-rpidistro-bcm43455 \
linux-firmware-rpidistro-bcm43456 \
bluez-firmware-rpidistro-bcm43430b0-hcd \
"
```
